## drivers/char/pppoesta/Kconfig
```kconfig
# /* < DTS2015050505491 hexinlong 20150505 begin */
#
# pppoesta device configuration
#

config PPPOESTA
           tristate "pppoe status Driver"
           default n
           help
           This is used to record the pppoe status.

# /* DTS2015050505491 hexinlong 20150505 end > */
```

## drivers/goldeneye/Kconfig
```kconfig
#/*< DTS2014122904893 shiguojun 20141229 begin */
config HUAWEI_GOLDENEYE
       bool "huawei goldeneye watchpoints feature support"
       default n
#/* DTS2014122904893 shiguojun 20141229 end >*/
```

## drivers/huawei/Kconfig
```kconfig
#/*< DTS2014122907589 mazhenhua 20141229 begin */
menu "huawei linux device driver support package"

source "drivers/huawei/store_exception/Kconfig"

endmenu
#/* DTS2014122907589 mazhenhua 20141229 end >*/
```

## drivers/huawei/store_exception/Kconfig
```kconfig
#/*< DTS2014122907589 mazhenhua 20141229 begin */
#/* < DTS2014082110037 chenqihang 20140821 begin */
menu HUAWEI_LOG_MODULE

config  HUAWEI_LOG_MODULE
        default n
	bool "huawei log module"
	help
          huawei log module control

endmenu

menu HUAWEI_STORE_EXCEPTION

config  HUAWEI_STORE_EXCEPTION
        default n
	bool "huawei store exception"
	help
          huawei store exception control

endmenu
#/* DTS2014082110037 chenqihang 20140821 end> */
#/* DTS2014122907589 mazhenhua 20141229 end >*/
```

## drivers/huawei_platform/sensor/accelerometer/Kconfig
```kconfig
#/* < DTS2015031902473 caowei 20150319 begin */
config HUAWEI_ACCEL_SENSORS_KIONIX
        tristate "ROHM_KX023 3-axis digital acceleromater"
        depends on I2C
	default n
        help
          Say Y here if you want to support ROHM_KX023 accelerometer connected via an I2C bus.
          to compile this driver as a module, choose M here: the module will be called kionix_accel.
 
config HUAWEI_ACCEL_SENSORS_LIS3DH
        tristate "ST LIS3DH 3-axis digital acceleromater"
        depends on I2C
        default n
	help
          Say Y here if you want to support STMicroelectronics LIS3DH accelerometer connected via an I2C bus.
          to compile this driver as a module, choose M here: the module will be called lis3dh_acc.
#/* < DTS2015112600367  chendong 20151126 begin */
config HUAWEI_ACCEL_SENSORS_BMA2x2
        tristate "BOSCH_BMA2X2 3-axis digital acceleromater"
        depends on I2C
	default n
        help
          Say Y here if you want to support BOSCH_BMA2X2 accelerometer connected via an I2C bus.
          to compile this driver as a module, choose M here: the module will be called bma2x2_accel.
config SENSORS_BMA2X2_ENABLE_INT1
	tristate "BMA2X2 acceleration sensor interrupt INT1 support"
	depends on HUAWEI_ACCEL_SENSORS_BMA2x2
	help
	 If you say yes here, you get INT1 support for Bosch Sensortec
	 acceleration sensors BMA255/BMA254/BMA355/BMA250E/BMA222E/BMA280.
	 Select it will disable interrupt INT2 support
	 
config SIG_MOTION
	tristate "support significant motion sensor function"
	depends on HUAWEI_ACCEL_SENSORS_BMA2x2  && ( SENSORS_BMA2X2_ENABLE_INT1 || SENSORS_BMA2X2_ENABLE_INT2)
	help
	 If you say yes here, if you want to support Bosch significant motion sensor function

config DOUBLE_TAP
	tristate "support double tap sensor function"
	depends on HUAWEI_ACCEL_SENSORS_BMA2x2  && ( SENSORS_BMA2X2_ENABLE_INT1 || SENSORS_BMA2X2_ENABLE_INT2)
	help
	 If you say yes here, you get support Bosch double tap sensor function
#/* DTS2015112600367  chendong 20151126 end > */
#/* DTS2015031902473 caowei 20150319 end > */
```

## drivers/huawei_platform/touchscreen/Kconfig
```kconfig
config CYTTSP5_CS445A
	tristate "cypress cs445a touch screen driver"
	default n
	help
	  Say Y here if you have cypress touch device us cyttsp5 to connected to your system and want
	  it to be available to applications. 
	  Say N here if you have no cypress touch device use cyttsp5 in your system.
	  If unsure, say Y.
	  To compile this driver as a module, choose M here: the
	  module will be called input.
source "drivers/huawei_platform/touchscreen/cyttsp5_cs445a/Kconfig"

config SYNAPTICS_DSX_S3207
	tristate "synaptics s3207 touch screen driver"
	default n
	help
	  Say Y here if you have synaptics s3207 device connected to your system and want
	  it to be available to applications. 
	  Say N here if you have no synaptics s3207 device in your system.
	  If unsure, say Y.
	  To compile this driver as a module, choose M here: the
	  module will be called input.
source "drivers/huawei_platform/touchscreen/synaptics_dsx_s3207/Kconfig"

config GT_9XX
	tristate "goodix touch screen driver"
	default n
	help
	  Say Y here if you have goodix touch device connected to your system and want
	  it to be available to applications. 
	  Say N here if you have no goodix touch device in your system.	  
	  If unsure, say Y.
	  To compile this driver as a module, choose M here: the
	  module will be called input.
source "drivers/huawei_platform/touchscreen/gt9xx/Kconfig"

config MSTAR_2142
	tristate "mstar 2142 touch screen driver"
	default n
	help
	  Say Y here if you have mstar 2142 touch device connected to your system and want
	  it to be available to applications. 
	  Say N here if you have no mstar 2142 touch device in your system.
	  If unsure, say Y.
	  To compile this driver as a module, choose M here: the
	  module will be called input.
source "drivers/huawei_platform/touchscreen/mstar_2142/Kconfig"

config FOCALTECH_6X36
	tristate "focaltech 6x06 touch screen driver"
	default n
	help
	  Say Y here if you have focaltech 6x06 touch device connected to your system and want
	  it to be available to applications. 
	  Say N here if you have no focaltech 6x06 touch device in your system.
	  If unsure, say Y.
	  To compile this driver as a module, choose M here: the
	  module will be called input.
source "drivers/huawei_platform/touchscreen/focaltech_6x36/Kconfig"

config NOVATEK_NT11206
	tristate "novatek nt11206b touch screen driver"
	default n
	help
	  Say Y here if you have novatek nt11206b touch device connected to your system and want
	  it to be available to applications. 
	  Say N here if you have no novatek nt11206b touch device in your system.
	  If unsure, say Y.
	  To compile this driver as a module, choose M here: the
	  module will be called input.
source "drivers/huawei_platform/touchscreen/nt11206b/Kconfig"

#/*< CPM2016032400222 shihuijun 20160324 begin */
config TOUCHSCREEN_HIMAX_HX852xF
	bool "Himax touchpanel HX852xF series"
	default n
	help
	  Say Y here if you have a Himax HX852xF touchscreen.
	  HX852xF controllers are multi touch controllers which can
	  report 10 touches at a time.
	  If unsure, say N.
	  To compile this driver as a module, choose M here: the
	  module will be called input.
source "drivers/huawei_platform/touchscreen/hx852xf/Kconfig"
#/* CPM2016032400222 shihuijun 20160324 end >*/
```

## drivers/input/fingerprint/Kconfig
```kconfig
#/*< DTS2015011503877 lijianzhao 20150115 begin */
config FINGERPRINT
	tristate "fingerprint"
	default n
	help
		If you say yes here you get support for fingerprint.
#/* DTS2015011503877 lijianzhao 20150115 end >*/
config FPC_NAV_UP_DOWN
	tristate "fingerprint navigation up/down feature"
	default n
	help
		If you say yes here you get support for fingerprint up & down navigation feature.
```

## drivers/misc/huawei_reset_detect/Kconfig
```kconfig
#/* < DTS2015012101808 chenxi 20150121 begin */
config HUAWEI_RESET_DETECT
	tristate "detect abnormal reset"
	depends on HUAWEI_KERNEL
	default n
	help
	  Say Y here to detect abnormal reset
#/* DTS2015012101808 chenxi 20150121 end > */
```

## drivers/power/msgnotify/Kconfig
```kconfig
# /* < DTS2015071700385 xujian 20150717 begin */
config HUAWEI_MSG_POLICY
	bool "Huawei msg policy"
	default n
	help
	  huawei msg policy
#/*  DTS2015071700385 xujian 20150717 end > */
```
