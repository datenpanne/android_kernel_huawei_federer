## arch/arm64/configs/msm_defconfig
```kconfig
CONFIG_SYSVIPC=y
CONFIG_NO_HZ=y
CONFIG_HIGH_RES_TIMERS=y
CONFIG_AUDIT=y
CONFIG_RCU_FAST_NO_HZ=y
CONFIG_IKCONFIG=y
#/* < DTS2015012601282 duanhuan 20150126 begin */
# CONFIG_IKCONFIG_PROC is not set
#/* DTS2015012601282 duanhuan 20150126 end > */
CONFIG_CGROUPS=y
CONFIG_CGROUP_DEBUG=y
CONFIG_CGROUP_FREEZER=y
CONFIG_CGROUP_CPUACCT=y
CONFIG_RESOURCE_COUNTERS=y
CONFIG_CGROUP_SCHED=y
CONFIG_RT_GROUP_SCHED=y
CONFIG_SCHED_HMP=y
CONFIG_NAMESPACES=y
# CONFIG_UTS_NS is not set
# CONFIG_IPC_NS is not set
# CONFIG_PID_NS is not set
# CONFIG_LEGACY_PTYS is not set
# CONFIG_INPUT_MOUSE is not set
CONFIG_RELAY=y
CONFIG_BLK_DEV_INITRD=y
CONFIG_RD_BZIP2=y
CONFIG_RD_LZMA=y
CONFIG_CC_OPTIMIZE_FOR_SIZE=y
CONFIG_PANIC_TIMEOUT=5
CONFIG_KALLSYMS_ALL=y
CONFIG_EMBEDDED=y
CONFIG_PROFILING=y
CONFIG_MODULES=y
CONFIG_MODULE_UNLOAD=y
CONFIG_MODULE_FORCE_UNLOAD=y
CONFIG_MODVERSIONS=y
CONFIG_MODULE_SIG=y
CONFIG_MODULE_SIG_FORCE=y
CONFIG_MODULE_SIG_SHA512=y
CONFIG_PARTITION_ADVANCED=y
CONFIG_ARCH_MSM=y
CONFIG_ARCH_MSM8916=y
CONFIG_LEDS_MSM_GPIO_FLASH=y
CONFIG_SMP=y
CONFIG_SCHED_MC=y
CONFIG_PREEMPT=y
CONFIG_ARMV7_COMPAT=y
CONFIG_BALANCE_ANON_FILE_RECLAIM=y
CONFIG_PROCESS_RECLAIM=y
# CONFIG_CORE_DUMP_DEFAULT_ELF_HEADERS is not set
CONFIG_COMPAT=y
CONFIG_PM_AUTOSLEEP=y
CONFIG_PM_WAKELOCKS=y
CONFIG_PM_WAKELOCKS_LIMIT=0
CONFIG_PM_RUNTIME=y
CONFIG_SUSPEND_TIME=y
CONFIG_CPU_FREQ=y
CONFIG_SCHED_FREQ_INPUT=y
CONFIG_CPU_FREQ_GOV_POWERSAVE=y
CONFIG_CPU_FREQ_GOV_USERSPACE=y
CONFIG_CPU_FREQ_GOV_ONDEMAND=y
CONFIG_CPU_FREQ_GOV_INTERACTIVE=y
CONFIG_CPU_IDLE=y
CONFIG_CPU_IDLE_MULTIPLE_DRIVERS=y
CONFIG_NET=y
CONFIG_PACKET=y
CONFIG_UNIX=y
CONFIG_XFRM_USER=y
CONFIG_INET=y
CONFIG_IP_ADVANCED_ROUTER=y
CONFIG_IP_MULTIPLE_TABLES=y
CONFIG_IP_ROUTE_VERBOSE=y
CONFIG_IP_PNP=y
CONFIG_IP_PNP_DHCP=y
CONFIG_INET_AH=y
CONFIG_INET_ESP=y
# CONFIG_INET_XFRM_MODE_BEET is not set
# CONFIG_INET_LRO is not set
CONFIG_IPV6=y
CONFIG_IPV6_PRIVACY=y
CONFIG_IPV6_ROUTER_PREF=y
CONFIG_IPV6_ROUTE_INFO=y
CONFIG_IPV6_OPTIMISTIC_DAD=y
CONFIG_INET6_AH=y
CONFIG_INET6_ESP=y
CONFIG_INET6_IPCOMP=y
CONFIG_IPV6_MIP6=y
CONFIG_IPV6_MULTIPLE_TABLES=y
CONFIG_IPV6_SUBTREES=y
CONFIG_NETFILTER=y
CONFIG_NF_CONNTRACK=y
CONFIG_NF_CONNTRACK_SECMARK=y
CONFIG_NF_CONNTRACK_EVENTS=y
CONFIG_NF_CT_PROTO_DCCP=y
CONFIG_NF_CT_PROTO_SCTP=y
CONFIG_NF_CT_PROTO_UDPLITE=y
CONFIG_NF_CONNTRACK_AMANDA=y
CONFIG_NF_CONNTRACK_FTP=y
CONFIG_NF_CONNTRACK_H323=y
CONFIG_NF_CONNTRACK_IRC=y
CONFIG_NF_CONNTRACK_NETBIOS_NS=y
CONFIG_NF_CONNTRACK_PPTP=y
CONFIG_NF_CONNTRACK_SANE=y
CONFIG_NF_CONNTRACK_SIP=y
CONFIG_NF_CONNTRACK_TFTP=y
CONFIG_NF_CT_NETLINK=y
CONFIG_NETFILTER_TPROXY=y
CONFIG_NETFILTER_XT_TARGET_CLASSIFY=y
CONFIG_NETFILTER_XT_TARGET_CONNMARK=y
CONFIG_NETFILTER_XT_TARGET_HARDIDLETIMER=y
CONFIG_NETFILTER_XT_TARGET_IDLETIMER=y
CONFIG_NETFILTER_XT_TARGET_CONNSECMARK=y
CONFIG_NETFILTER_XT_TARGET_LOG=y
CONFIG_NETFILTER_XT_TARGET_MARK=y
CONFIG_NETFILTER_XT_TARGET_NFLOG=y
CONFIG_NETFILTER_XT_TARGET_NFQUEUE=y
CONFIG_NETFILTER_XT_TARGET_NOTRACK=y
CONFIG_NETFILTER_XT_TARGET_SECMARK=y
CONFIG_NETFILTER_XT_TARGET_TPROXY=y
CONFIG_NETFILTER_XT_TARGET_TRACE=y
#/* < DTS2015060800573 huangpei 20150608 begin */
CONFIG_NETFILTER_XT_TARGET_TCPMSS=y
#/* DTS2015060800573 huangpei 20150608 end > */
CONFIG_NETFILTER_XT_MATCH_COMMENT=y
CONFIG_NETFILTER_XT_MATCH_CONNLIMIT=y
CONFIG_NETFILTER_XT_MATCH_CONNMARK=y
CONFIG_NETFILTER_XT_MATCH_CONNTRACK=y
CONFIG_NETFILTER_XT_MATCH_DSCP=y
CONFIG_NETFILTER_XT_MATCH_ESP=y
CONFIG_NETFILTER_XT_MATCH_HASHLIMIT=y
CONFIG_NETFILTER_XT_MATCH_HELPER=y
CONFIG_NETFILTER_XT_MATCH_IPRANGE=y
CONFIG_NETFILTER_XT_MATCH_LENGTH=y
CONFIG_NETFILTER_XT_MATCH_LIMIT=y
CONFIG_NETFILTER_XT_MATCH_MAC=y
CONFIG_NETFILTER_XT_MATCH_MARK=y
CONFIG_NETFILTER_XT_MATCH_MULTIPORT=y
CONFIG_NETFILTER_XT_MATCH_POLICY=y
CONFIG_NETFILTER_XT_MATCH_PKTTYPE=y
CONFIG_NETFILTER_XT_MATCH_QTAGUID=y
CONFIG_NETFILTER_XT_MATCH_QUOTA=y
CONFIG_NETFILTER_XT_MATCH_QUOTA2=y
CONFIG_NETFILTER_XT_MATCH_QUOTA2_LOG=y
CONFIG_NETFILTER_XT_MATCH_SOCKET=y
CONFIG_NETFILTER_XT_MATCH_STATE=y
CONFIG_NETFILTER_XT_MATCH_STATISTIC=y
CONFIG_NETFILTER_XT_MATCH_STRING=y
CONFIG_NETFILTER_XT_MATCH_TIME=y
CONFIG_NETFILTER_XT_MATCH_U32=y
CONFIG_NF_CONNTRACK_IPV4=y
CONFIG_IP_NF_IPTABLES=y
CONFIG_IP_NF_MATCH_AH=y
CONFIG_IP_NF_MATCH_ECN=y
CONFIG_IP_NF_MATCH_TTL=y
CONFIG_IP_NF_FILTER=y
CONFIG_IP_NF_TARGET_REJECT=y
CONFIG_NF_NAT_IPV4=y
CONFIG_IP_NF_TARGET_MASQUERADE=y
CONFIG_IP_NF_TARGET_NETMAP=y
CONFIG_IP_NF_TARGET_REDIRECT=y
CONFIG_IP_NF_MANGLE=y
CONFIG_IP_NF_RAW=y
CONFIG_IP_NF_SECURITY=y
CONFIG_IP_NF_ARPTABLES=y
CONFIG_IP_NF_ARPFILTER=y
CONFIG_IP_NF_ARP_MANGLE=y
CONFIG_NF_CONNTRACK_IPV6=y
CONFIG_IP6_NF_IPTABLES=y
CONFIG_IP6_NF_FILTER=y
CONFIG_IP6_NF_TARGET_REJECT=y
CONFIG_IP6_NF_MANGLE=y
CONFIG_IP6_NF_RAW=y
CONFIG_BRIDGE_NF_EBTABLES=y
CONFIG_BRIDGE_EBT_BROUTE=y
CONFIG_BRIDGE=y
CONFIG_NET_SCHED=y
CONFIG_NET_SCH_HTB=y
CONFIG_NET_SCH_PRIO=y
CONFIG_NET_CLS_FW=y
CONFIG_NET_CLS_U32=y
CONFIG_CLS_U32_MARK=y
CONFIG_NET_CLS_FLOW=y
CONFIG_NET_EMATCH=y
CONFIG_NET_EMATCH_CMP=y
CONFIG_NET_EMATCH_NBYTE=y
CONFIG_NET_EMATCH_U32=y
CONFIG_NET_EMATCH_META=y
CONFIG_NET_EMATCH_TEXT=y
CONFIG_NET_CLS_ACT=y
CONFIG_RMNET_DATA=y
CONFIG_RMNET_DATA_FC=y
CONFIG_RMNET_DATA_DEBUG_PKT=y
CONFIG_BT=y
CONFIG_BT_RFCOMM=y
CONFIG_BT_RFCOMM_TTY=y
CONFIG_BT_BNEP=y
CONFIG_BT_BNEP_MC_FILTER=y
CONFIG_BT_BNEP_PROTO_FILTER=y
CONFIG_BT_HIDP=y
CONFIG_MSM_BT_POWER=y
CONFIG_CFG80211=y
CONFIG_NL80211_TESTMODE=y
CONFIG_CFG80211_INTERNAL_REGDB=y
CONFIG_RFKILL=y
CONFIG_NFC_QNCI=y
CONFIG_IPC_ROUTER=y
CONFIG_IPC_ROUTER_SECURITY=y
CONFIG_CMA=y
CONFIG_CMA_SIZE_MBYTES=8
CONFIG_BLK_DEV_LOOP=y
CONFIG_BLK_DEV_RAM=y
#/* < DTS2015031902473 caowei 20150319 begin */
#/* < DTS2015112600367  chendong 20151126 begin */
CONFIG_HUAWEI_ACCEL_SENSORS_BMA2x2=y
CONFIG_SENSORS_BMA2X2_ENABLE_INT1=y
#/* < DTS2016040502547 chendong 20160407 begin */
CONFIG_HUAWEI_LP_SENSORS_AP3426=y
CONFIG_HUAWEI_LP_SENSORS_AP34XX=n
#/*  DTS2016040502547 chendong 20160407 end >*/
#/* DTS2015112600367  chendong 20151126 end > */
CONFIG_HUAWEI_SENSOR_INFO=y
CONFIG_SENSOR_INFO=y
CONFIG_HUAWEI_LP_SENSORS_ROHM_RPR521=y
CONFIG_HUAWEI_LP_SENSORS_APDS993X=y
#/* < DTS2015082101986 wushengyu 20150821 begin */
CONFIG_HUAWEI_LP_SENSORS_APDS9251=y
#/* DTS2015082101986 wushengyu 20150407 end > */
CONFIG_HUAWEI_LP_SENSORS_ROHM_RGB_BH1745=y
CONFIG_HUAWEI_HALL_SENSORS_AK8789=y
CONFIG_HUAWEI_ACCEL_SENSORS_KIONIX=y
CONFIG_HUAWEI_LP_SENSORS_PA224=y
CONFIG_HUAWEI_ACCEL_SENSORS_LIS3DH=y
CONFIG_HUAWEI_COMPASS_SENSORS_AKM09911=y
CONFIG_HUAWEI_LP_SENSORS_ADUX1050=y
CONFIG_EVAL=y
CONFIG_USE_FILP=y
#CONFIG_ADUX1050_POLL is not set
#/* DTS2015031902473 caowei 20150319 end > */
#/* < DTS2015010600226 wangcunyou 20140106 begin */

#/* DTS2015010600226 wangcunyou 20140106 end > */
#/* < DTS2014051304400 caowei 201400515 begin */

#/* < DTS2014052206888 yangxiaomei 20140523 begin */
#/* < DTS2015020511013 wangcunyou 20150205 begin */

#/* DTS2015020511013 wangcunyou 20150205 end > */

#/* DTS2014052206888 yangxiaomei 20140523 end > */
#/* DTS2014051304400 caowei 201400515 end >*/
#/* < DTS2014120903191 yuanzhen 20141209 begin */
#/* < DTS2014092403407  zengwei/WX221991 20140928 begain refer to DTS2014081805982*/
#/* DTS2014120903191 yuanzhen 20141209 end > */
#/* < DTS2015020511013 wangcunyou 20150205 begin */
CONFIG_HUAWEI_SENSOR_SELF_ADAPT=y
#/* DTS2015020511013 wangcunyou 20150205 end > */
#/* DTS2014092403407  zengwei/WX221991 20140928 end > */
#/* < DTS2014042306752 yangxiaomei 20140424 begin */
#/* DTS2014042306752 yangxiaomei 20140424 end > */
#/* < DTS2014041705903 zhangmin 20140418 begin */
CONFIG_HUAWEI_HW_DEV_DCT=y
#/* DTS2014041705903 zhangmin 20140418 end > */
CONFIG_QSEECOM=y
CONFIG_SCSI=y
CONFIG_SCSI_TGT=y
CONFIG_BLK_DEV_SD=y
CONFIG_CHR_DEV_SG=y
CONFIG_CHR_DEV_SCH=y
CONFIG_SCSI_MULTI_LUN=y
CONFIG_SCSI_CONSTANTS=y
CONFIG_SCSI_LOGGING=y
CONFIG_SCSI_SCAN_ASYNC=y
CONFIG_MD=y
CONFIG_BLK_DEV_DM=y
CONFIG_DM_CRYPT=y
CONFIG_DM_REQ_CRYPT=y
CONFIG_DM_VERITY=y
CONFIG_NETDEVICES=y
CONFIG_DUMMY=y
CONFIG_MII=y
CONFIG_TUN=y
CONFIG_MSM_RMNET_BAM=y
CONFIG_PHYLIB=y
CONFIG_PPP=y
CONFIG_PPP_BSDCOMP=y
CONFIG_PPP_DEFLATE=y
CONFIG_PPPOE=y
CONFIG_PPP_ASYNC=y
CONFIG_PPP_SYNC_TTY=y
CONFIG_WCNSS_CORE=y
CONFIG_WCNSS_CORE_PRONTO=y
CONFIG_WCNSS_MEM_PRE_ALLOC=y
CONFIG_WCNSS_REGISTER_DUMP_ON_BITE=y
CONFIG_INPUT_EVDEV=y
CONFIG_INPUT_EVBUG=m
CONFIG_KEYBOARD_GPIO=y
CONFIG_INPUT_TOUCHSCREEN=y
CONFIG_TOUCHSCREEN_SYNAPTICS_DSX_CORE_v21=y
CONFIG_TOUCHSCREEN_SYNAPTICS_DSX_RMI_DEV_v21=y
CONFIG_TOUCHSCREEN_SYNAPTICS_DSX_FW_UPDATE_v21=y
CONFIG_TOUCHSCREEN_ATMEL_MXT=y
CONFIG_TOUCHSCREEN_FT5X06=y
CONFIG_TOUCHSCREEN_MSTAR21XX=y
CONFIG_TOUCHSCREEN_GEN_VKEYS=y
#/* < DTS2015031902473 caowei 20150319 begin */
CONFIG_SYNAPTICS_DSX_S3207=y
#/* DTS2015031902473 caowei 20150319 end > */
CONFIG_TOUCHSCREEN_SYNAPTICS_I2C_RMI4=y
CONFIG_TOUCHSCREEN_SYNAPTICS_DSX_RMI4_DEV=y
CONFIG_TOUCHSCREEN_SYNAPTICS_DSX_FW_UPDATE=y
#/* < DTS2014122210216 songrongyuan 20141222 begin */
#/* < DTS2014111804457 caowei 20141118 begin */
#/* < DTS2015031902473 caowei 20150319 begin */
CONFIG_CYTTSP5_CS445A=y
#/* DTS2015031902473 caowei 20150319 end > */
CONFIG_TOUCHSCREEN_CYPRESS_CYTTSP5=y
CONFIG_TOUCHSCREEN_CYPRESS_CYTTSP5_DEVICETREE_SUPPORT=y
CONFIG_TOUCHSCREEN_CYPRESS_CYTTSP5_MT_B=y
CONFIG_TOUCHSCREEN_CYPRESS_CYTTSP5_BUTTON=y
#CONFIG_TOUCHSCREEN_CYPRESS_CYTTSP5_PROXIMITY is not set
CONFIG_TOUCHSCREEN_CYPRESS_CYTTSP5_I2C=y
CONFIG_TOUCHSCREEN_CYPRESS_CYTTSP5_LOADER=y
CONFIG_TOUCHSCREEN_CYPRESS_CYTTSP5_DEVICE_ACCESS=y
CONFIG_TOUCHSCREEN_CYPRESS_CYTTSP5_PLATFORM_FW_UPGRADE=n
CONFIG_TOUCHSCREEN_CYPRESS_CYTTSP5_BINARY_FW_UPGRADE=y
CONFIG_TOUCHSCREEN_CYPRESS_CYTTSP5_MANUAL_TTCONFIG_UPGRADE=y
CONFIG_TOUCHSCREEN_CYPRESS_CYTTSP5_PLATFORM_TTCONFIG_UPGRADE=y
#/* DTS2014111804457 caowei 20141118 end> */
#/* DTS2014122210216 songrongyuan 20141222 end > */
CONFIG_TOUCHSCREEN_BU21150=y
CONFIG_INPUT_MT_WRAPPER=y
CONFIG_INPUT_MISC=y
CONFIG_INPUT_HBTP_INPUT=y
CONFIG_SENSORS_MPU6050=y
CONFIG_INPUT_UINPUT=y
CONFIG_INPUT_GPIO=m
CONFIG_SENSORS_MMC3416X=y
#/* < DTS2015031902473 caowei 20150319 begin */
CONFIG_SENSORS_AKM09911=n
#/* DTS2015031902473 caowei 20150319 end > */
CONFIG_SENSORS_AKM8963=y
#/* < DTS2015112600367  chendong 20151126 begin */
#CONFIG_SENSORS_BMA2X2 is not set
#/* DTS2015112600367  chendong 20151126 end > */
# CONFIG_SERIO_I8042 is not set
# CONFIG_VT is not set
CONFIG_SERIAL_MSM_HS=y
CONFIG_SERIAL_MSM_HSL=y
#/*<DTS2015011403845 liyuping 20150114 begin*/
#/* < DTS2015011603405 zhaiqi 20150116 begin */
CONFIG_SERIAL_MSM_HSL_CONSOLE=y
#/* DTS2015011603405 zhaiqi 20150116 end > */  
#/*DTS2015011403845 liyuping 20150114 end>*/
CONFIG_SERIAL_MSM_SMD=y
CONFIG_DIAG_CHAR=y
CONFIG_HW_RANDOM=y
CONFIG_HW_RANDOM_MSM=y
CONFIG_MSM_SMD_PKT=y
CONFIG_MSM_ADSPRPC=y
CONFIG_I2C=y
CONFIG_I2C_CHARDEV=y
CONFIG_I2C_MSM_V2=y
CONFIG_SLIMBUS_MSM_NGD=y
CONFIG_SPI=y
CONFIG_SPI_QUP=y
#/*< DTS2015061808948 tongyongjiao 20150619 begin */
# CONFIG_SPI_SPIDEV is not set
#/* DTS2015061808948 tongyongjiao 20150619 end > */
CONFIG_SPMI=y
CONFIG_SPMI_MSM_PMIC_ARB=y
CONFIG_MSM_QPNP_INT=y
CONFIG_USE_PINCTRL_IRQ=y
CONFIG_PINCTRL_MSM_TLMM=y
CONFIG_GPIO_SYSFS=y
CONFIG_GPIO_QPNP_PIN=y
CONFIG_SMB1360_CHARGER_FG=y
CONFIG_BATTERY_BCL=y
CONFIG_QPNP_VM_BMS=y
CONFIG_QPNP_LINEAR_CHARGER=y
CONFIG_POWER_RESET_MSM=y
CONFIG_MSM_DLOAD_MODE=y
CONFIG_MSM_PM=y
CONFIG_SENSORS_QPNP_ADC_VOLTAGE=y
CONFIG_THERMAL=y
CONFIG_THERMAL_TSENS8974=y
CONFIG_THERMAL_MONITOR=y
CONFIG_THERMAL_QPNP=y
CONFIG_THERMAL_QPNP_ADC_TM=y
CONFIG_REGULATOR=y
CONFIG_REGULATOR_FIXED_VOLTAGE=y
CONFIG_REGULATOR_PROXY_CONSUMER=y
CONFIG_REGULATOR_FAN53555=y
CONFIG_REGULATOR_MEM_ACC=y
CONFIG_REGULATOR_ONSEMI_NCP6335D=y
CONFIG_REGULATOR_TPS65132=y
CONFIG_REGULATOR_STUB=y
CONFIG_REGULATOR_RPM_SMD=y
CONFIG_REGULATOR_QPNP=y
CONFIG_REGULATOR_SPM=y
CONFIG_REGULATOR_CPR=y
CONFIG_MEDIA_SUPPORT=y
CONFIG_MEDIA_CAMERA_SUPPORT=y
CONFIG_MEDIA_RADIO_SUPPORT=y
CONFIG_MEDIA_CONTROLLER=y
CONFIG_VIDEO_V4L2_SUBDEV_API=y
CONFIG_VIDEOBUF2_MSM_MEM=y
CONFIG_MEDIA_USB_SUPPORT=y
CONFIG_USB_VIDEO_CLASS=y
CONFIG_V4L_PLATFORM_DRIVERS=y
CONFIG_MSMB_CAMERA=y
CONFIG_MSM_CAMERA_SENSOR=y
CONFIG_MSM_CPP=y
CONFIG_MSM_CCI=y
CONFIG_MSM_CSI30_HEADER=y
CONFIG_MSM_CSIPHY=y
CONFIG_MSM_CSID=y
CONFIG_MSM_EEPROM=y
CONFIG_MSM_ISPIF=y
CONFIG_HI256=y
CONFIG_MT9M114=y
CONFIG_OV5645=y
CONFIG_MSM_V4L2_VIDEO_OVERLAY_DEVICE=y
CONFIG_MSMB_JPEG=y
CONFIG_MSM_VIDC_V4L2=y
CONFIG_RADIO_IRIS=y
CONFIG_RADIO_IRIS_TRANSPORT=m
CONFIG_MSM_KGSL=y
CONFIG_KGSL_PER_PROCESS_PAGE_TABLE=y
CONFIG_FB=y
CONFIG_FB_MSM=y
CONFIG_FB_MSM_MDSS=y
CONFIG_FB_MSM_MDSS_WRITEBACK=y
CONFIG_SOUND=y
CONFIG_SND=y
CONFIG_SND_USB_AUDIO=y
CONFIG_SND_SOC=y
CONFIG_SND_SOC_MSM8X16=y
CONFIG_UHID=y
CONFIG_HID_APPLE=y
CONFIG_HID_ELECOM=y
CONFIG_HID_MAGICMOUSE=y
CONFIG_HID_MICROSOFT=y
CONFIG_HID_MULTITOUCH=y
CONFIG_USB=y
CONFIG_USB_ANNOUNCE_NEW_DEVICES=y
CONFIG_USB_MON=y
CONFIG_USB_XHCI_HCD=y
CONFIG_USB_EHCI_HCD=y
CONFIG_USB_EHCI_EHSET=y
CONFIG_USB_EHCI_MSM=y
CONFIG_USB_EHCI_MSM_UICC=y
CONFIG_USB_ICE40_HCD=y
CONFIG_USB_ACM=y
CONFIG_USB_CCID_BRIDGE=y
CONFIG_USB_STORAGE=y
CONFIG_USB_STORAGE_DATAFAB=y
CONFIG_USB_STORAGE_FREECOM=y
CONFIG_USB_STORAGE_ISD200=y
CONFIG_USB_STORAGE_USBAT=y
CONFIG_USB_STORAGE_SDDR09=y
CONFIG_USB_STORAGE_SDDR55=y
CONFIG_USB_STORAGE_JUMPSHOT=y
CONFIG_USB_STORAGE_ALAUDA=y
CONFIG_USB_STORAGE_KARMA=y
CONFIG_USB_STORAGE_CYPRESS_ATACB=y
CONFIG_USB_SERIAL=y
CONFIG_USB_SERIAL_CSVT=y
CONFIG_USB_EHSET_TEST_FIXTURE=y
CONFIG_USB_PHY=y
CONFIG_USB_MSM_SSPHY_QMP=y
CONFIG_MSM_QUSB_PHY=y
CONFIG_USB_GADGET=y
CONFIG_USB_GADGET_DEBUG_FILES=y
CONFIG_USB_GADGET_DEBUG_FS=y
CONFIG_USB_CI13XXX_MSM=y
CONFIG_USB_DWC3_MSM=y
CONFIG_USB_G_ANDROID=y
CONFIG_MMC=y
CONFIG_MMC_PERF_PROFILING=y
CONFIG_MMC_UNSAFE_RESUME=y
CONFIG_MMC_CLKGATE=y
CONFIG_MMC_PARANOID_SD_INIT=y
CONFIG_MMC_BLOCK_MINORS=32
CONFIG_MMC_TEST=m
#/* < DTS2014112404668 wangwenlei 20141124 begin */
CONFIG_HW_MMC_TEST=y
#/* DTS2014112404668 wangwenlei 20141124 end > */
CONFIG_MMC_BLOCK_TEST=m
CONFIG_MMC_SDHCI=y
CONFIG_MMC_SDHCI_PLTFM=y
CONFIG_MMC_SDHCI_MSM=y
CONFIG_LEDS_TRIGGERS=y
CONFIG_SWITCH=y
CONFIG_RTC_CLASS=y
CONFIG_RTC_DRV_QPNP=y
CONFIG_UIO=y
CONFIG_UIO_MSM_SHAREDMEM=y
CONFIG_STAGING=y
CONFIG_ZSMALLOC=y
CONFIG_ZRAM=y
CONFIG_ANDROID=y
CONFIG_ANDROID_BINDER_IPC=y
CONFIG_ASHMEM=y
CONFIG_ANDROID_LOGGER=y
CONFIG_ANDROID_LOW_MEMORY_KILLER=y
CONFIG_ANDROID_INTF_ALARM_DEV=y
CONFIG_ONESHOT_SYNC=y
CONFIG_ION=y
CONFIG_ION_MSM=y
CONFIG_SPS=y
CONFIG_USB_BAM=y
CONFIG_SPS_SUPPORT_NDP_BAM=y
CONFIG_QPNP_POWER_ON=y
CONFIG_QPNP_VIBRATOR=y
CONFIG_LEDS_GPIO=y
CONFIG_LEDS_QPNP=y
CONFIG_LEDS_TRIGGERS=y
CONFIG_QPNP_REVID=y
CONFIG_QPNP_COINCELL=y
CONFIG_PFT=y
CONFIG_MSM_AVTIMER=y
CONFIG_MSM_BUS_SCALING=y
CONFIG_BUS_TOPOLOGY_ADHOC=y
CONFIG_MSM_MDSS_PLL=y
CONFIG_REMOTE_SPINLOCK_MSM=y
CONFIG_MSM_IOMMU_V1=y
CONFIG_PWM=y
CONFIG_PWM_QPNP=y
CONFIG_CORESIGHT=y
CONFIG_CORESIGHT_EVENT=y
CONFIG_CORESIGHT_FUSE=y
CONFIG_CORESIGHT_CTI=y
CONFIG_CORESIGHT_TMC=y
CONFIG_CORESIGHT_TPIU=y
CONFIG_CORESIGHT_FUNNEL=y
CONFIG_CORESIGHT_REPLICATOR=y
CONFIG_CORESIGHT_STM=y
CONFIG_CORESIGHT_HWEVENT=y
CONFIG_CORESIGHT_ETMV4=y
CONFIG_CORESIGHT_MODEM_ETM=y
CONFIG_CORESIGHT_WCN_ETM=y
CONFIG_CORESIGHT_RPM_ETM=y
CONFIG_SENSORS=y
CONFIG_SENSORS_SSC=y
CONFIG_CP_ACCESS64=y
CONFIG_MSM_BAM_DMUX=y
CONFIG_MSM_IPC_ROUTER_SMD_XPRT=y
CONFIG_MSM_QMI_INTERFACE=y
CONFIG_MSM_SMD=y
CONFIG_MSM_SMD_DEBUG=y
CONFIG_MSM_RPM_SMD=y
CONFIG_MSM_RPM_LOG=y
CONFIG_MSM_RPM_STATS_LOG=y
CONFIG_MSM_RUN_QUEUE_STATS=y
CONFIG_MSM_SMEM=y
CONFIG_MSM_SMEM_LOGGING=y
CONFIG_MSM_SMP2P=y
CONFIG_MSM_SMP2P_TEST=y
CONFIG_MSM_SPM=y
CONFIG_MSM_L2_SPM=y
CONFIG_MSM_ADSP_LOADER=y
CONFIG_MSM_MEMORY_DUMP_V2=y
CONFIG_MSM_DEBUG_LAR_UNLOCK=y
CONFIG_MSM_WATCHDOG_V2=y
CONFIG_MSM_FORCE_WDOG_BITE_ON_PANIC=y
CONFIG_MSM_SUBSYSTEM_RESTART=y
CONFIG_MSM_COMMON_LOG=y
CONFIG_MSM_SYSMON_COMM=y
CONFIG_MSM_PIL=y
CONFIG_MSM_PIL_SSR_GENERIC=y
CONFIG_MSM_PIL_MSS_QDSP6V5=y
CONFIG_MSM_OCMEM=y
CONFIG_MSM_OCMEM_LOCAL_POWER_CTRL=y
CONFIG_MSM_OCMEM_DEBUG=y
CONFIG_MSM_OCMEM_NONSECURE=y
CONFIG_MSM_SCM=y
CONFIG_MEM_SHARE_QMI_SERVICE=y
CONFIG_MSM_TZ_LOG=y
CONFIG_EXT2_FS=y
CONFIG_EXT2_FS_XATTR=y
CONFIG_EXT3_FS=y
# CONFIG_EXT3_DEFAULTS_TO_ORDERED is not set
CONFIG_EXT4_FS=y
CONFIG_EXT4_FS_SECURITY=y
CONFIG_FUSE_FS=y
CONFIG_VFAT_FS=y
CONFIG_TMPFS=y
CONFIG_NLS_CODEPAGE_437=y
CONFIG_NLS_ASCII=y
CONFIG_NLS_ISO8859_1=y
CONFIG_PRINTK_TIME=y
CONFIG_MAGIC_SYSRQ=y
CONFIG_LOCKUP_DETECTOR=y
CONFIG_BOOTPARAM_SOFTLOCKUP_PANIC=y
# CONFIG_DETECT_HUNG_TASK is not set
CONFIG_SCHEDSTATS=y
CONFIG_TIMER_STATS=y
CONFIG_DEBUG_KMEMLEAK=y
CONFIG_DEBUG_KMEMLEAK_DEFAULT_OFF=y
#/* < DTS2015040804369 zhaiqi 20150408 begin */
# CONFIG_DEBUG_SPINLOCK is not set
# CONFIG_DEBUG_MUTEXES is not set
# CONFIG_DEBUG_ATOMIC_SLEEP is not set
CONFIG_DEBUG_STACK_USAGE=y
CONFIG_DEBUG_INFO=y
CONFIG_DEBUG_MEMORY_INIT=y
# CONFIG_DEBUG_LIST is not set
CONFIG_FAULT_INJECTION=y
# CONFIG_FAIL_PAGE_ALLOC is not set
# CONFIG_FAULT_INJECTION_DEBUG_FS is not set
#/* DTS2015040804369 zhaiqi 20150408 end > */
CONFIG_FAULT_INJECTION_STACKTRACE_FILTER=y
CONFIG_MSM_RTB=y
CONFIG_MSM_RTB_SEPARATE_CPUS=y
CONFIG_IPC_LOGGING=y
CONFIG_DYNAMIC_DEBUG=y
CONFIG_PANIC_ON_DATA_CORRUPTION=y
CONFIG_KEYS=y
CONFIG_SECURITY=y
CONFIG_SECURITY_NETWORK=y
CONFIG_LSM_MMAP_MIN_ADDR=4096
CONFIG_SECURITY_SELINUX=y
CONFIG_CRYPTO_NULL=y
CONFIG_CRYPTO_XTS=y
CONFIG_CRYPTO_XCBC=y
CONFIG_CRYPTO_MD4=y
CONFIG_CRYPTO_ARC4=y
CONFIG_CRYPTO_TWOFISH=y
CONFIG_CRYPTO_DEV_QCRYPTO=y
CONFIG_CRYPTO_DEV_QCE=y
CONFIG_CRYPTO_DEV_QCEDEV=y
CONFIG_ARM64_CRYPTO=y
CONFIG_CRYPTO_SHA1_ARM64_CE=y
CONFIG_CRYPTO_SHA2_ARM64_CE=y
CONFIG_CRYPTO_GHASH_ARM64_CE=y
CONFIG_CRYPTO_AES_ARM64_CE=y
CONFIG_CRYPTO_AES_ARM64_CE_CCM=y
CONFIG_CRYPTO_AES_ARM64_CE_BLK=y
CONFIG_CRYPTO_AES_ARM64_NEON_BLK=y
CONFIG_QMI_ENCDEC=y
CONFIG_STRICT_MEMORY_RWX=y
CONFIG_MSM_PERFORMANCE=y
CONFIG_MOBICORE_SUPPORT=m
CONFIG_MOBICORE_API=m
#/* < DTS2014041008275 chenjikun 20140410 begin */
CONFIG_HUAWEI_WIFI=y
#/* DTS2014041008275 chenjikun 20140410 end > */
#/* <DTS2014080900552 chenyuanquan 20140825 begin */
#MAX77819 related config
CONFIG_MFD_MAX77819=y
CONFIG_CHARGER_MAX77819=y
CONFIG_BATTERY_MAX17048=y
CONFIG_BACKLIGHT_MAX77819=y
#MAX77819 config end
#/* DTS2014080900552 chenyuanquan 20140825 end> */
CONFIG_HUAWEI_KERNEL=y
#/* < DTS2014111407354  weiqiangqiang 20141115 begin */
#/* < DTS2014112904825 duanhuan 20141129 begin */
CONFIG_FEATURE_HUAWEI_EMERGENCY_DATA=y
CONFIG_EXT4_HUAWEI_READ_ONLY_RECOVERY=y
CONFIG_HW_FEATURE_STORAGE_DIAGNOSE_LOG=y
#/* DTS2014112904825 duanhuan 20141129 end > */
#/* < DTS2014042402686 sunlibin 20140424 begin */
#/*Add synaptics new driver "Synaptics DSX I2C V2.0"*/
CONFIG_TOUCHSCREEN_HUAWEI_SYNAPTICS_DSX_v20=y
CONFIG_TOUCHSCREEN_HUAWEI_DSX_I2C=y
CONFIG_TOUCHSCREEN_HUAWEI_DSX_RMI_DEV=y
CONFIG_TOUCHSCREEN_HUAWEI_DSX_FW_UPDATE=y
CONFIG_TOUCHSCREEN_HUAWEI_DSX_TEST_REPORTING=y
#/* < DTS2014120600813 songrongyuan 20141212 begin */
# CONFIG_TOUCHSCREEN_HUAWEI_DSX_PROXIMITY is not set
#/* DTS2014120600813 songrongyuan 20141212 end > */
#/* DTS2014042402686 sunlibin 20140424 end> */
CONFIG_TOUCHSCREEN_HUAWEI_DSX_ESD=y
#/* DTS2014111407354  weiqiangqiang 20141115 end >*/
CONFIG_HUAWEI_DSM=y
CONFIG_APP_INFO=y
#/* <DTS2015012202482 jiangfei 20150122 begin */
#/* < DTS2015061809777 mapengfei 20150619 begin */
CONFIG_CHARGER_BQ24152=y
CONFIG_BATTERY_BQ27510=y
#/* DTS2015061809777 mapengfei 20150619 end > */
#/* DTS2015012202482 jiangfei 20150122 end> */
#/* <DTS2014121201578 jiangfei 20141212 begin */
CONFIG_BQ24296M_CHARGER=y
#/* DTS2014121201578 jiangfei 20141212 end> */
#/* < DTS2014071502649  tanyanying 20140714 begin */
CONFIG_HUAWEI_THERMAL=y
#/* DTS2014071502649  tanyanying 20140714 end > */
#/*<DTS2014071602538 wuliuzhen 20140716 begin*/
CONFIG_INPUT_HW_ATE=y
#/* DTS2014071602538 wuliuzhen 20140716 end >*/
#/* < DTS2014050804174 wanghui 20140523 begin */
CONFIG_HUAWEI_USB=y
#/* DTS2014050804174 wanghui 20140523 end > */
#/* < DTS2014041201607 yangxiaocong 20140412 begin */
CONFIG_HUAWEI_AUDIO_INFO=y
#/* DTS2014041201607 yangxiaocong 20140412 end > */
#/* < DTS2014042500432 zhaoyuxia 20140225 begin */
CONFIG_HUAWEI_LCD=y
#/* DTS2014042500432 zhaoyuxia 20140225 end > */
#/*< DTS2014052207729 renxigang 20140520 begin */
CONFIG_FB_MSM_MDSS_DSI_CTRL_STATUS=y
#/* DTS2014052207729 renxigang 20140520 end >*/
#/* <DTS2014042409252 d00238048 20140505 begin */
CONFIG_FB_AUTO_CABC=y
#/* DTS2014042409252 d00238048 20140505 end> */
CONFIG_LOG_BUF_SHIFT=20
#/*< DTS2014111906886 luchao 20141119 begin */
CONFIG_SDCARD_FS=y
CONFIG_SDCARD_FS_FADV_NOACTIVE=y
#/* DTS2014111906886 luchao 20141119 end>*/
#/* < DTS2014112602903 zhongming 20141126 begin */
CONFIG_HUAWEI_KSTATE=y
#/* DTS2014112602903 zhongming 20141126 end > */
#/* < DTS2014112402783 mazhenhua 20141124 begin */
CONFIG_INPUT_KEYCHORD=y
#/* DTS2014112402783 mazhenhua 20141124 end > */
# /* < DTS2014112704100 zhaiqi 20141127 begin */
#CONFIG_HUAWEI_KERNEL_DEBUG=y
# /* DTS2014112704100 zhaiqi 20141127 end > */
#/* < DTS2014112803242 wenshuai 20141129 begin */
CONFIG_IP_MULTICAST=y
#/* DTS2014112803242 wenshuai 20141129 end > */
#/* < DTS2014120902096 duanhuan 20141209 begin */
#/* < DTS2015071004504 duanhuan 20150710 begin */
#CONFIG_HUAWEI_EMMC_DSM_DEBUG is not set
#/* DTS2015071004504 duanhuan 20150710 end > */
#/* DTS2014120902096 duanhuan 20141209 end > */
#/* < DTS2015042905057 duanhuan 20150429 begin */
#remove it
#/* DTS2015042905057 duanhuan 20150429 end > */
#/* < DTS2014112902721 zhaiqi 20141129 begin */
CONFIG_DEBUG_VMALLOC=y
#/* DTS2014112902721 zhaiqi 20141129 end > */
#/* < DTS2014112404668 wangwenlei 20141124 begin */
CONFIG_HW_SYSTEM_WR_PROTECT=y
#/* DTS2014112404668 wangwenlei 20141124 end > */
# /*< DTS2014122000264 zhaiqi 20141220 begin */
CONFIG_ZSMALLOC=y
CONFIG_ZRAM=y
CONFIG_SWAP=y
# /* DTS2014122000264 zhaiqi 20141220 end >*/
#/* < DTS2014120207212 lizhigang 20141202 begin */
CONFIG_HW_MMC_TOSHIBA_HEALTH_API=y
#/* DTS2014120207212 lizhigang 20141202 end > */
#/*< DTS2014121606144 luchao 20141216 begin */
CONFIG_HUAWEI_SDCARD_DSM=y
#/* DTS2014121606144 luchao 20141216 end>*/
#/* < DTS2014122400303 yuanzhen 20141224 begin */
CONFIG_SWITCH_USB_CLS=y
CONFIG_SWITCH_FSA9685=y
#/* DTS2014122400303 yuanzhen 20141224 end > */
#/* < DTS2014121603568 wenshuai 20141202 begin */
CONFIG_HUAWEI_FEATURE_DIAG_MDLOG=y
#/* DTS2014121603568 wenshuai 20141202 end > */
#/* < DTS2014121802462 wenshuai 20141218 begin */
CONFIG_HUAWEI_USB_DSM=y
#/* DTS2014121802462 wenshuai 20141218 end > */
#/* < DTS2014122502944 wenshuai 20141230 begin */
CONFIG_NET_KEY=y
CONFIG_PPP_MULTILINK=y
CONFIG_PPP_FILTER=y
CONFIG_PPP_MPPE=y
CONFIG_PPPOL2TP=y
CONFIG_SLIP=y
CONFIG_PPPOATM=y
CONFIG_CRYPTO_AES=y
CONFIG_PPPOLAC=y
CONFIG_PPPOPNS=y
#/* DTS2014122502944 wenshuai 20141230 end > */
#/* < DTS2014122907766 chenxi 20141229 begin */
CONFIG_HUAWEI_EXTERN_ID_DETECT=y
#/* DTS2014122907766 chenxi 20141229 end > */
#/* < DTS2014122903325 sihongfang 20141229 begin */
CONFIG_DETECT_HUNG_TASK=y
CONFIG_HW_DETECT_HUNG_TASK=y
CONFIG_DEFAULT_HUNG_TASK_TIMEOUT=120
CONFIG_BOOTPARAM_HUNG_TASK_PANIC_VALUE=0
#/* DTS2014122903325 sihongfang 20141229 end > */
#/*< DTS2014122904893 shiguojun 20141229 begin */
CONFIG_TASKSTATS=y
CONFIG_TASK_XACCT=y
CONFIG_TASK_DELAY_ACCT=y
CONFIG_TASK_IO_ACCOUNTING=y
CONFIG_HUAWEI_GOLDENEYE=y
# /* < DTS2015013003082 sihongfang 20150202 begin */
CONFIG_DEBUG_SPINLOCK_PANIC_ON_BUG=y
# /* DTS2015013003082 sihongfang 20150202 end >*/
#/* DTS2014122904893 shiguojun 20141229 end >*/
#/*< DTS2014122907589 mazhenhua 20141229 begin */
CONFIG_HUAWEI_STORE_EXCEPTION=y
#/* DTS2014122907589 mazhenhua 20141229 end >*/
#/*<DTS2015010901930 lijiechun/l00101002 20150109 begin */
CONFIG_LOG_JANK=y
#/*<DTS2015010901930 lijiechun/l00101002 20150109 end */
#/* < DTS2015011403834 zhaoyingchun 20150114 begin */
CONFIG_HUAWEI_DEBUG_MODE=y
#/* DTS2015011403834 zhaoyingchun 20150114 end > */
#/*< DTS2015011503877 lijianzhao 20150115 begin */
CONFIG_FINGERPRINT=y
CONFIG_FPC_NAV_UP_DOWN=n
#/* DTS2015011503877 lijianzhao 20150115 end >*/
#/* < DTS2015012101808 chenxi 20150121 begin */
CONFIG_HUAWEI_RESET_DETECT=y
#/* DTS2015012101808 chenxi 20150121 end > */
#/* < DTS2015012801593 zhaoyingchun 20150128 begin */
CONFIG_MMC_FFU=y
CONFIG_MMC_SWRM=y
#/* DTS2015012801593 zhaoyingchun 20150128 end > */
#/*< DTS2015020402929 mazhenhua 20150205 begin */
CONFIG_PAGE_POISONING=y
#/* < DTS2015040804369 zhaiqi 20150408 begin */
# CONFIG_DEBUG_PAGEALLOC is not set
CONFIG_PAGE_OWNER=y
# CONFIG_SLUB_DEBUG is not set
# CONFIG_SLUB_DEBUG_ON is not set
#/* DTS2015040804369 zhaiqi 20150408 end > */
CONFIG_PANIC_ON_OOPS=y
#/* DTS2015020402929 mazhenhua 20150205 end >*/
#/* DTS2015012910874 dingjingfeng 20150206 begin> */
#/* DTS2015012910874 dingjingfeng 20150206 end> */
#/* < DTS2015030501960 zengwei 20150306  begin */
CONFIG_NLS_UTF8=y
CONFIG_EXFAT_FS=y
CONFIG_EXFAT_DEFAULT_CODEPAGE=437
CONFIG_EXFAT_DEFAULT_IOCHARSET="utf8"
#/* DTS2015030501960 zengwei 20150306  end > */
#/* < DTS2015030702430 chenxi 20150307 begin */
CONFIG_MSM_XPU_ERR_FATAL=y
#/* DTS2015030702430 chenxi 20150307 end > */
# /* DTS2014122903419 qidechun/yantongguang 2015-03-13 begin */
CONFIG_SRECORDER=y
CONFIG_SRECORDER_IMEM_HEADER_PHYS_ADDR=0x08600AE0
CONFIG_SRECORDER_IMEM_HEADER_PHYS_SIZE=0x00000018
CONFIG_SRECORDER_LOG_BUF_LEN=0x00200000
# /* DTS2014122903419 qidechun/yantongguang 2015-03-13 end */
#/* < DTS2015032608630 sihongfang 20150326 begin*/
CONFIG_HUAWEI_FEATURE_NFF=y
#/* DTS2015032608630 sihongfang 20150326 end > */
#/* <DTS2015033000764 jiangfei 20150330 begin */
CONFIG_HUAWEI_PMU_DSM=y
#/* DTS2015033000764 jiangfei 20150330 end> */
CONFIG_MSM_CORE_CTL_HELPER=y
# /* < DTS2015050505491 hexinlong 20150505 begin */
CONFIG_PPPOESTA=y
# /* DTS2015050505491 hexinlong 20150505 end > */
#/* < DTS2015050708048 hexinlong 20150507 begin */
CONFIG_HUAWEI_LOG_PARSER=y
#/* DTS2015050708048 hexinlong 20150507 end > */
# /* < DTS2015052904471 rachit 20150529 begin */
CONFIG_CGROUP_PIDS=y
# /* DTS2015052904471 rachit 20150529 end > */
#/* < DTS2015052701547 zengwei 20150619 begin */
CONFIG_SDCARD_FS_CI_SEARCH=y
#/* DTS2015052701547 zengwei 20150619 end > */
# /* < DTS2015061706215 rachit 20150617 begin */
CONFIG_CGROUP_PIDS_NOTIFY_USER=y
# /* DTS2015061706215 rachit 20150617 end > */
# /* < DTS2015071700385 xujian 20150717 begin */
CONFIG_HUAWEI_MSG_POLICY=y
# /*  DTS2015071700385 xujian 20150717 end > */
# /* DTS2015070910693, l00208949, 20150709 begin */
CONFIG_HUAWEI_OBA=y
# /* DTS2015070910693, l00208949, 20150709 end */
#/* < DTS2015100903237  zengwei 20151009 begin */
CONFIG_MMC_BLOCK_DEFERRED_RESUME=y
#/* DTS2015100903237  zengwei 20151009 end > */
#/* < DTS2016020500646  lvxinkai/wx270663 20160205 begin */
CONFIG_CPUSETS=y
CONFIG_PROC_PID_CPUSET=y
CONFIG_SHRINK_MEMORY=y
#/* < DTS2016020500646  lvxinkai/wx270663 20160205 end */
```
