/* < DTS2014120503050 lixiuzhen 20141205 begin */
/* < DTS2015031004345 menglingchao 20150310 begin */
 / {
        huawei_fac_info {
                  compatible = "huawei,hw_fac_info";
                  fac,product_name = "HUAWEI RIO-L03";
                  fac,hardware_ver = "HL1RIOL01M";
                  fac,software_ver = "MSM8939_RIO_L03_VA";
                  status = "ok";
        };
};
/* DTS2015031004345 menglingchao 20150310 end > */
/* DTS2014120503050 lixiuzhen 20141205 end > */
