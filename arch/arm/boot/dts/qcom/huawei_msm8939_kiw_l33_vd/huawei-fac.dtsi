/* < DTS2015111200926 c00248442 20151112 begin */
 / {
        huawei_fac_info {
                  compatible = "huawei,hw_fac_info";
                  fac,product_name = "HUAWEI KIW-L33";
                  fac,hardware_ver = "HL3KIWMAY";
                  fac,software_ver = "MSM8939_KIW_L33_VD";
                  status = "ok";
        };
};
/* < DTS2015111200926 c00248442 20151112 end */
