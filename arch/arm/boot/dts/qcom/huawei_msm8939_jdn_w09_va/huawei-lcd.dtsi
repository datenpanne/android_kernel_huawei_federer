/*---------------------------------------------------------------------------
 * This file is autogenerated file using huawei LCD parser. Please do not edit it.
 * Update input XML file to add a new entry or update variable in this file
 * Parser location: device/qcom/common/display/tools/huawei_lcd_panel 
 *---------------------------------------------------------------------------*/


#include "hw-panel-auo-nt51021-8-1200p-video.dtsi"
#include "hw-panel-fake-nt51021-10-1200p-video.dtsi"
#include "hw-panel-inx-nt51021-8-1200p-video.dtsi"
