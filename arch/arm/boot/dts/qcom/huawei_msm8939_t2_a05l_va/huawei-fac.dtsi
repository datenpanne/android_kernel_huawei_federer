 / {
        huawei_fac_info {
                  compatible = "huawei,hw_fac_info";
                  fac,product_name = "HUAWEI FDR-A05L";
                  fac,hardware_ver = "SH1FDRA05LM_VERA";
                  fac,software_ver = "MSM8939_FDR_A05L_VA";
                  status = "ok";
        };
};
