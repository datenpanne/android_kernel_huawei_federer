/* < DTS2015030601036 lixiuzhen 20150306 begin */
&spmi_bus{
	qcom,pm8916@1 {
		pm8916_vib: qcom,vibrator@c000 {
		compatible = "qcom,qpnp-vibrator";
		qcom,vib-timeout-ms = <15000>;
		/* < DTS2015041102544 wushengyu 20150411 begin */
		qcom,vib-vtg-level-mV = <3000>;
		/* DTS2015041102544 wushengyu 20150411 end > */
		reg = <0xc000 0x100>;
		label = "vibrator";
		status = "ok";
		};
	};
};
/* DTS2015030601036 lixiuzhen 20150306 end > */
