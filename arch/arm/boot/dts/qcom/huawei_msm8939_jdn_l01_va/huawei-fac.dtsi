 / {
        huawei_fac_info {
                  compatible = "huawei,hw_fac_info";
                  fac,product_name = "HUAWEI JDN-L01";
                  fac,hardware_ver = "SH1JDNL01LM";
                  fac,software_ver = "MSM8939_JDN_L01_VA";
                  status = "ok";
        };
};
