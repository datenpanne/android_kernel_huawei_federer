/* < DTS2014120503050 lixiuzhen 20141205 begin */
/* < DTS2015031004345 menglingchao 20150310 begin */
/* < DTS2015072900946 goupeipei 20150729 begin */
 / {
        huawei_fac_info {
                  compatible = "huawei,hw_fac_info";
                  fac,product_name = "HUAWEI ATH-UL01";
                  fac,hardware_ver = "HL1ATHUL01M";
                  fac,software_ver = "MSM8939_ATH_UL01_VC";
                  status = "ok";
        };
};
/* DTS2015072900946 goupeipei 20150729 end> */
/* DTS2015031004345 menglingchao 20150310 end > */
/* DTS2014120503050 lixiuzhen 20141205 end > */
