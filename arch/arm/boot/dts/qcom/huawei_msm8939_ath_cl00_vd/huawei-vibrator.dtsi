/* < DTS2015072404956 goupeipei 20150724 begin */
/* < DTS2014121804508 wangcunyou 20141218 begin */
&spmi_bus{
	qcom,pm8916@1 {
		pm8916_vib: qcom,vibrator@c000 {
		compatible = "qcom,qpnp-vibrator";
		qcom,vib-timeout-ms = <15000>;
		qcom,vib-vtg-level-mV = <2800>;
		reg = <0xc000 0x100>;
		label = "vibrator";
		status = "ok";
		};
	};
};
/* DTS2014121804508 wangcunyou 20141218 end > */
/* DTS2015072404956 goupeipei 20150724 end > */
