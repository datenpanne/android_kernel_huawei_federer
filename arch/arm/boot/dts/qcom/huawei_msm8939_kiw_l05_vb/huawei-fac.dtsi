/*< DTS2015121404544  c00248442 20151214 begin */
 / {
        huawei_fac_info {
                  compatible = "huawei,hw_fac_info";
                  fac,product_name = "HUAWEI KII-L05";
                  fac,hardware_ver = "HL3KIWMBF";
                  fac,software_ver = "MSM8939_KII_L05_VB";
                  status = "ok";
        };
};
/* DTS2015121404544 c00248442 20151214 end> */
