/* < DTS2015082103023 l00133898 20150822 begin */
/* < DTS2015072802954 lwx247446 20150728 begin */
/* < DTS2015071605523 guotiecheng 20150716 begin */
 / {
        huawei_fac_info {
                  compatible = "huawei,hw_fac_info";
                  fac,product_name = "HUAWEI FDR-A01W";
                  fac,hardware_ver = "SH1FDRA01WM_VERA";
                  fac,software_ver = "MSM8939_FDR_A01W_VA";
                  status = "ok";
        };
};
/* DTS2015071605523 guotiecheng 20150716 end >*/
/* DTS2015072802954 lwx247446 20150728 end > */
/* DTS2015082103023 l00133898 20150822 end > */