/* < DTS2015111200926 c00248442 20151112 begin */
 / {
        huawei_bt_info {
                  compatible = "huawei,hw_bt_info";
                  status = "ok";
                  bt,fw_ver = "QCOM_WCN3620_2.0.1";
                  bt,chiptype = "BT_FM_QUALCOMM_WCN3620";
        };
};
/* < DTS2015111200926 c00248442 20151112 end */
