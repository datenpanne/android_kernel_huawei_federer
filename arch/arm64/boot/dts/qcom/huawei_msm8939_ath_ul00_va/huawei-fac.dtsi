/* < DTS2014120503050 lixiuzhen 20141205 begin */
/* < DTS2015031004345 menglingchao 20150310 begin */
 / {
        huawei_fac_info {
                  compatible = "huawei,hw_fac_info";
                  fac,product_name = "HUAWEI ATH-UL00";
                  fac,hardware_ver = "HL1ATHAL00M";
                  fac,software_ver = "MSM8939_ATH_UL00_VA";
                  status = "ok";
        };
};
/* DTS2015031004345 menglingchao 20150310 end > */
/* DTS2014120503050 lixiuzhen 20141205 end > */
