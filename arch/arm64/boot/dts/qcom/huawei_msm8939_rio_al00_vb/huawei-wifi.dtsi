/* < DTS2015030601036 lixiuzhen 20150306 begin */
/* < DTS2015031002564 caoliang 20150310 begin */
 / {
        huawei_wifi_info {
                  compatible = "huawei,hw_wifi_info";
                  status = "ok";
                  wifi,chiptype = "2.3";
                  wifi,pubfile_id = "rio_al00";
                  wifi,fw_ver = "QCOM_WCN3620_2.0.1";
                  wifi,softap_feature = "wps";
        };
};
/* DTS2015031002564 caoliang 20150310 end > */
/* DTS2015030601036 lixiuzhen 20150306 end > */