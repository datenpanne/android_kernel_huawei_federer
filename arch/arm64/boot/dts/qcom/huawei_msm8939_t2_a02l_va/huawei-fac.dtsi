/* < DTS2015082103023 l00133898 20150822 begin */
/* < DTS2015071605523 guotiecheng 20150716 begin */
 / {
        huawei_fac_info {
                  compatible = "huawei,hw_fac_info";
                  fac,product_name = "HUAWEI FDR-A02L";
                  fac,hardware_ver = "SH1FDRA02LM_VERA";
                  fac,software_ver = "MSM8939_FDR_A02L_VA";
                  status = "ok";
        };
};
/* DTS2015071605523 guotiecheng 20150716 end >*/
/* DTS2015082103023 l00133898 20150822 end > */