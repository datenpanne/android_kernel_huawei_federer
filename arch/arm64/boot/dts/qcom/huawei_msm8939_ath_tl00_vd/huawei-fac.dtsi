/* < DTS2014120503050 lixiuzhen 20141205 begin */
/* < DTS2015031004345 menglingchao 20150310 begin */
/* < DTS2015072404956 goupeipei 20150724 begin */
 / {
        huawei_fac_info {
                  compatible = "huawei,hw_fac_info";
                  fac,product_name = "HUAWEI ATH-TL00";
                  fac,hardware_ver = "HL1ATHAL00M";
                  fac,software_ver = "MSM8939_ATH_TL00_VD/UL00/TL00H";
                  status = "ok";
        };
};
/* DTS2015072404956 goupeipei 20150724 end > */
/* DTS2015031004345 menglingchao 20150310 end > */
/* DTS2014120503050 lixiuzhen 20141205 end > */
