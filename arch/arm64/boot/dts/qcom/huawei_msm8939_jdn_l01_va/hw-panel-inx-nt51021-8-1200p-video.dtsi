/* Copyright (c) 2013, The Linux Foundation. All rights reserved.
 *
 * This program is free software; you can redistribute it and/or modify
 * it under the terms of the GNU General Public License version 2 and
 * only version 2 as published by the Free Software Foundation.
 *
 * This program is distributed in the hope that it will be useful,
 * but WITHOUT ANY WARRANTY; without even the implied warranty of
 * MERCHANTABILITY or FITNESS FOR A PARTICULAR PURPOSE.  See the
 * GNU General Public License for more details.
 */

/*---------------------------------------------------------------------------
 * This file is autogenerated file using gcdb parser. Please do not edit it.
 * Update input XML file to add a new entry or update variable in this file
 * VERSION = "1.0"
 *---------------------------------------------------------------------------*/
&mdss_mdp {
	dsi_inx_nt51021_8_1200p_video: qcom,mdss_dsi_inx_nt51021_8_1200p_video {
		qcom,mdss-dsi-panel-name = "INX_NT51021_8_1200P_VIDEO";
		qcom,cont-splash-enabled;
		qcom,mdss-dsi-panel-controller = <&mdss_dsi0>;
		qcom,mdss-dsi-panel-type = "dsi_video_mode";
		qcom,mdss-dsi-panel-destination = "display_1";
		qcom,mdss-dsi-panel-framerate = <60>;
		qcom,mdss-dsi-virtual-channel-id = <0>;
		qcom,mdss-dsi-stream = <0>;
		qcom,mdss-dsi-panel-width = <1200>;
		qcom,mdss-dsi-panel-height = <1920>;
		qcom,mdss-dsi-h-front-porch = <64>;
		qcom,mdss-dsi-h-back-porch = <36>;
		qcom,mdss-dsi-h-pulse-width = <4>;
		qcom,mdss-dsi-h-sync-skew = <0>;
		qcom,mdss-dsi-v-back-porch = <24>;
		qcom,mdss-dsi-v-front-porch = <104>;
		qcom,mdss-dsi-v-pulse-width = <2>;
		qcom,mdss-dsi-h-left-border = <0>;
		qcom,mdss-dsi-h-right-border = <0>;
		qcom,mdss-dsi-v-top-border = <0>;
		qcom,mdss-dsi-v-bottom-border = <0>;
		qcom,mdss-dsi-bpp = <24>;
		qcom,mdss-dsi-underflow-color = <0xff>;
		qcom,mdss-dsi-border-color = <0>;
		qcom,mdss-dsi-color-order = "rgb_swap_rgb";
		qcom,mdss-dsi-on-command = [15 01 00 00 06 00 02 8FA5
	15 01 00 00 18 00 02 01 00
	15 01 00 00 00 00 02 8FA5
	15 01 00 00 00 00 02 83 00
	15 01 00 00 00 00 02 84 00
	15 01 00 00 00 00 02 9f 00
	15 01 00 00 00 00 02 83 BB
	15 01 00 00 00 00 02 84 22
	15 01 00 00 00 00 02 90 00
	15 01 00 00 00 00 02 96 00
	15 01 00 00 00 00 02 91 A0
	15 01 00 00 00 00 02 9A 10
	15 01 00 00 00 00 02 94 18
	15 01 00 00 00 00 02 95 60
	15 01 00 00 00 00 02 A1 FF
	15 01 00 00 00 00 02 A2 FE
	15 01 00 00 00 00 02 A3 FE
	15 01 00 00 00 00 02 A4 FC
	15 01 00 00 00 00 02 A5 FA
	15 01 00 00 00 00 02 A6 FA
	15 01 00 00 00 00 02 A7 F7
	15 01 00 00 00 00 02 A8 F5
	15 01 00 00 00 00 02 A9 F5
	15 01 00 00 00 00 02 AA F3
	15 01 00 00 00 00 02 B4 06
	15 01 00 00 00 00 02 B5 0C
	15 01 00 00 00 00 02 B6 0A
	15 01 00 00 00 00 02 83 AA
	15 01 00 00 00 00 02 84 11
	15 01 00 00 00 00 02 A9 4B
	15 01 00 00 00 00 02 83 00
	15 01 00 00 00 00 02 84 00
	15 01 00 00 00 00 02 8C 04
	15 01 00 00 00 00 02 FD 53
	15 01 00 00 00 00 02 FA 0E
	15 01 00 00 00 00 02 83 AA
	15 01 00 00 00 00 02 84 11
	15 01 00 00 00 00 02 C0 00
	15 01 00 00 00 00 02 C1 01
	15 01 00 00 00 00 02 C2 0B
	15 01 00 00 00 00 02 C3 17
	15 01 00 00 00 00 02 C4 22
	15 01 00 00 00 00 02 C5 2A
	15 01 00 00 00 00 02 C6 32
	15 01 00 00 00 00 02 C7 38
	15 01 00 00 00 00 02 C8 3E
	15 01 00 00 00 00 02 C9 8D
	15 01 00 00 00 00 02 CA 8D
	15 01 00 00 00 00 02 CB A0
	15 01 00 00 00 00 02 CC AF
	15 01 00 00 00 00 02 CD B3
	15 01 00 00 00 00 02 CE AC
	15 01 00 00 00 00 02 CF AF
	15 01 00 00 00 00 02 D0 AD
	15 01 00 00 00 00 02 D1 B1
	15 01 00 00 00 00 02 D2 BB
	15 01 00 00 00 00 02 D3 CF
	15 01 00 00 00 00 02 D4 CF
	15 01 00 00 00 00 02 D5 6B
	15 01 00 00 00 00 02 D6 70
	15 01 00 00 00 00 02 D7 73
	15 01 00 00 00 00 02 D8 7C
	15 01 00 00 00 00 02 D9 80
	15 01 00 00 00 00 02 DA 89
	15 01 00 00 00 00 02 DB 95
	15 01 00 00 00 00 02 DC B3
	15 01 00 00 00 00 02 DD B4
	15 01 00 00 00 00 02 DE 00
	15 01 00 00 00 00 02 DF 20
	15 01 00 00 00 00 02 E0 26
	15 01 00 00 00 00 02 E1 27
	15 01 00 00 00 00 02 E2 31
	15 01 00 00 00 00 02 E3 3B
	15 01 00 00 00 00 02 E4 48
	15 01 00 00 00 00 02 E5 52
	15 01 00 00 00 00 02 E6 58
	15 01 00 00 00 00 02 E7 5E
	15 01 00 00 00 00 02 E8 64
	15 01 00 00 00 00 02 E9 D7
	15 01 00 00 00 00 02 EA D4
	15 01 00 00 00 00 02 EB EB
	15 01 00 00 00 00 02 EC FC
	15 01 00 00 00 00 02 ED FF
	15 01 00 00 00 00 02 EE F9
	15 01 00 00 00 00 02 EF FB
	15 01 00 00 00 00 02 F0 F9
	15 01 00 00 00 00 02 F1 FD
	15 01 00 00 00 00 02 F2 06
	15 01 00 00 00 00 02 F3 1C
	15 01 00 00 00 00 02 F4 1B
	15 01 00 00 00 00 02 F5 91
	15 01 00 00 00 00 02 F6 96
	15 01 00 00 00 00 02 F7 99
	15 01 00 00 00 00 02 F8 A2
	15 01 00 00 00 00 02 F9 A7
	15 01 00 00 00 00 02 FA AD
	15 01 00 00 00 00 02 FB B1
	15 01 00 00 00 00 02 FC B3
	15 01 00 00 00 00 02 FD B4
	15 01 00 00 00 00 02 FE 00
	15 01 00 00 00 00 02 FF 2E
	15 01 00 00 00 00 02 83 BB
	15 01 00 00 00 00 02 84 22
	15 01 00 00 00 00 02 C0 00
	15 01 00 00 00 00 02 C1 01
	15 01 00 00 00 00 02 C2 0B
	15 01 00 00 00 00 02 C3 17
	15 01 00 00 00 00 02 C4 22
	15 01 00 00 00 00 02 C5 2A
	15 01 00 00 00 00 02 C6 32
	15 01 00 00 00 00 02 C7 38
	15 01 00 00 00 00 02 C8 3E
	15 01 00 00 00 00 02 C9 8D
	15 01 00 00 00 00 02 CA 90
	15 01 00 00 00 00 02 CB A3
	15 01 00 00 00 00 02 CC B2
	15 01 00 00 00 00 02 CD B6
	15 01 00 00 00 00 02 CE B2
	15 01 00 00 00 00 02 CF B5
	15 01 00 00 00 00 02 D0 B3
	15 01 00 00 00 00 02 D1 BF
	15 01 00 00 00 00 02 D2 CE
	15 01 00 00 00 00 02 D3 E7
	15 01 00 00 00 00 02 D4 EC
	15 01 00 00 00 00 02 D5 7C
	15 01 00 00 00 00 02 D6 82
	15 01 00 00 00 00 02 D7 88
	15 01 00 00 00 00 02 D8 90
	15 01 00 00 00 00 02 D9 98
	15 01 00 00 00 00 02 DA 9F
	15 01 00 00 00 00 02 DB AA
	15 01 00 00 00 00 02 DC C7
	15 01 00 00 00 00 02 DD CA
	15 01 00 00 00 00 02 DE 00
	15 01 00 00 00 00 02 DF 20
	15 01 00 00 00 00 02 E0 26
	15 01 00 00 00 00 02 E1 27
	15 01 00 00 00 00 02 E2 31
	15 01 00 00 00 00 02 E3 3B
	15 01 00 00 00 00 02 E4 48
	15 01 00 00 00 00 02 E5 52
	15 01 00 00 00 00 02 E6 58
	15 01 00 00 00 00 02 E7 5E
	15 01 00 00 00 00 02 E8 64
	15 01 00 00 00 00 02 E9 D7
	15 01 00 00 00 00 02 EA D7
	15 01 00 00 00 00 02 EB EE
	15 01 00 00 00 00 02 EC FF
	15 01 00 00 00 00 02 ED 02
	15 01 00 00 00 00 02 EE FF
	15 01 00 00 00 00 02 EF 01
	15 01 00 00 00 00 02 F0 FF
	15 01 00 00 00 00 02 F1 0B
	15 01 00 00 00 00 02 F2 19
	15 01 00 00 00 00 02 F3 34
	15 01 00 00 00 00 02 F4 38
	15 01 00 00 00 00 02 F5 A2
	15 01 00 00 00 00 02 F6 A8
	15 01 00 00 00 00 02 F7 AE
	15 01 00 00 00 00 02 F8 B6
	15 01 00 00 00 00 02 F9 BF
	15 01 00 00 00 00 02 FA C4
	15 01 00 00 00 00 02 FB C7
	15 01 00 00 00 00 02 FC C7
	15 01 00 00 00 00 02 FD CA
	15 01 00 00 00 00 02 FE 50
	15 01 00 00 00 00 02 FF 2F
	15 01 00 00 00 00 02 83 CC
	15 01 00 00 00 00 02 84 33
	15 01 00 00 00 00 02 C0 00
	15 01 00 00 00 00 02 C1 01
	15 01 00 00 00 00 02 C2 0B
	15 01 00 00 00 00 02 C3 17
	15 01 00 00 00 00 02 C4 22
	15 01 00 00 00 00 02 C5 2A
	15 01 00 00 00 00 02 C6 32
	15 01 00 00 00 00 02 C7 38
	15 01 00 00 00 00 02 C8 3E
	15 01 00 00 00 00 02 C9 8D
	15 01 00 00 00 00 02 CA 90
	15 01 00 00 00 00 02 CB A5
	15 01 00 00 00 00 02 CC B4
	15 01 00 00 00 00 02 CD BB
	15 01 00 00 00 00 02 CE B8
	15 01 00 00 00 00 02 CF BB
	15 01 00 00 00 00 02 D0 BD
	15 01 00 00 00 00 02 D1 CC
	15 01 00 00 00 00 02 D2 DF
	15 01 00 00 00 00 02 D3 FE
	15 01 00 00 00 00 02 D4 08
	15 01 00 00 00 00 02 D5 90
	15 01 00 00 00 00 02 D6 97
	15 01 00 00 00 00 02 D7 9E
	15 01 00 00 00 00 02 D8 A8
	15 01 00 00 00 00 02 D9 B1
	15 01 00 00 00 00 02 DA BC
	15 01 00 00 00 00 02 DB D8
	15 01 00 00 00 00 02 DC EF
	15 01 00 00 00 00 02 DD FF
	15 01 00 00 00 00 02 DE 00
	15 01 00 00 00 00 02 DF 28
	15 01 00 00 00 00 02 E0 26
	15 01 00 00 00 00 02 E1 27
	15 01 00 00 00 00 02 E2 31
	15 01 00 00 00 00 02 E3 3B
	15 01 00 00 00 00 02 E4 48
	15 01 00 00 00 00 02 E5 52
	15 01 00 00 00 00 02 E6 58
	15 01 00 00 00 00 02 E7 5E
	15 01 00 00 00 00 02 E8 64
	15 01 00 00 00 00 02 E9 D7
	15 01 00 00 00 00 02 EA D7
	15 01 00 00 00 00 02 EB F0
	15 01 00 00 00 00 02 EC 02
	15 01 00 00 00 00 02 ED 07
	15 01 00 00 00 00 02 EE 05
	15 01 00 00 00 00 02 EF 07
	15 01 00 00 00 00 02 F0 09
	15 01 00 00 00 00 02 F1 18
	15 01 00 00 00 00 02 F2 2A
	15 01 00 00 00 00 02 F3 4B
	15 01 00 00 00 00 02 F4 54
	15 01 00 00 00 00 02 F5 B6
	15 01 00 00 00 00 02 F6 BD
	15 01 00 00 00 00 02 F7 C4
	15 01 00 00 00 00 02 F8 CE
	15 01 00 00 00 00 02 F9 D8
	15 01 00 00 00 00 02 FA E1
	15 01 00 00 00 00 02 FB ED
	15 01 00 00 00 00 02 FC EF
	15 01 00 00 00 00 02 FD FF
	15 01 00 00 00 00 02 FE F8
	15 01 00 00 00 00 02 FF 2F
	15 01 00 00 00 00 02 83 00
	15 01 00 00 00 00 02 84 00
	05 01 00 00 18 00 02 11 00];
		qcom,mdss-dsi-off-command = [15 01 00 00 64 00 02 10 00];
		qcom,mdss-dsi-on-command-state = "dsi_lp_mode";
		qcom,mdss-dsi-off-command-state = "dsi_hs_mode";
		qcom,mdss-dsi-h-sync-pulse = <1>;
		qcom,mdss-dsi-traffic-mode = "burst_mode";
		qcom,mdss-dsi-lane-map = "lane_map_0123";
		qcom,mdss-dsi-bllp-eof-power-mode;
		qcom,mdss-dsi-bllp-power-mode;
		qcom,mdss-dsi-set-high-speed;
		qcom,mdss-dsi-lane-0-state;
		qcom,mdss-dsi-lane-1-state;
		qcom,mdss-dsi-lane-2-state;
		qcom,mdss-dsi-lane-3-state;
		qcom,mdss-dsi-panel-timings = [F8 3C 28 00 6E 72 2E 40 30 03 04 00];
		qcom,mdss-dsi-t-clk-post = <0x02>;
		qcom,mdss-dsi-t-clk-pre = <0x2D>;
		qcom,mdss-dsi-bl-min-level = <4>;
		qcom,mdss-dsi-bl-max-level = <255>;
		qcom,mdss-dsi-dma-trigger = "trigger_sw";
		qcom,mdss-dsi-mdp-trigger = "none";
		qcom,mdss-dsi-bl-pmic-control-type = "bl_ctrl_dcs";
		qcom,panel-inverse-off-cmds = [05 01 00 00 00 00 02 20 00];
		qcom,panel-inverse-on-cmds = [05 01 00 00 00 00 02 21 00];
		qcom,panel-cabc-off-cmds = [15 01 00 00 00 00 02 83 BB
	15 01 00 00 00 00 02 84 22
	15 01 00 00 00 00 02 90 C0];
		qcom,panel-cabc-moving-cmds = [15 01 00 00 00 00 02 83 BB
	15 01 00 00 00 00 02 84 22
	15 01 00 00 00 00 02 90 00];
		qcom,cabc-off-cmds-dsi-state = "dsi_hs_mode";
		qcom,cabc-moving-cmds-dsi-state = "dsi_hs_mode";
		qcom,inverse-on-cmds-dsi-state = "dsi_lp_mode";
		qcom,inverse-off-cmds-dsi-state = "dsi_lp_mode";
		qcom,panel-cabc-ui-cmds = [];
		qcom,panel-cabc-video-cmds = [];
		qcom,cabc-ui-cmds-dsi-state = "dsi_hs_mode";
		qcom,cabc-video-cmds-dsi-state = "dsi_hs_mode";
		qcom,mdss-dsi-lp11-init;
		qcom,mdss-pan-physical-width-dimension = <135>;
		qcom,mdss-pan-physical-height-dimension = <217>;
		qcom,mdss-dsi-mipi-rst-delay = <80>;
		huawei,skip-reg-read-flag = <1>;
		huawei,product-pad-flag = <1>;
		huawei,which-product-pad = <2>;
		huawei,rg-led-flag = <1>;
		huawei,rg-led-para1 = <10>;
		huawei,rg-led-para2 = <30218>;
			qcom,mdss-dsi-reset-sequence = <1 1>, <0 20>, <1 30>;

	};
};
