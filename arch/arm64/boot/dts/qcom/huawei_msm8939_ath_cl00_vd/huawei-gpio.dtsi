/* < DTS2015072404956 goupeipei 20150724 begin */
/* < DTS2015011303362 xupeipei 20150113 begin */
/* < DTS2015021203041 zwx221429 20150312 begin */
/* Copyright (c) 2013, The Linux Foundation. All rights reserved.
 *
 * This program is free software; you can redistribute it and/or modify
 * it under the terms of the GNU General Public License version 2 and
 * only version 2 as published by the Free Software Foundation.
 *
 * This program is distributed in the hope that it will be useful,
 * but WITHOUT ANY WARRANTY; without even the implied warranty of
 * MERCHANTABILITY or FITNESS FOR A PARTICULAR PURPOSE.  See the
 * GNU General Public License for more details.
 */

&soc {
nc_gpio {
    compatible = "qcom,sleep_gpio";
    ngpio = <10>;
    gpio = <29 30 77 81 94 101 102 116 119>;
    status = "okay";
    };
};
/* DTS2015021203041 zhoujian zwx221429 20150312 end > */
/* DTS2015011303362 xupeipei 20150113 end > */
/* DTS2015072404956 goupeipei 20150724 end > */
