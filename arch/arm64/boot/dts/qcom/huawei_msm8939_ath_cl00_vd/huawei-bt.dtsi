/* < DTS2015072404956 goupeipei 20150724 begin */
/* < DTS2014041604760 shaopengxiang 20140417 begin */
/* < DTS2015012009883 wangjian 20140121 begin */
 / {
        huawei_bt_info {
                  compatible = "huawei,hw_bt_info";
                  status = "ok";
                  bt,fw_ver = "QCOM_WCN3620_2.0.1";
                  bt,chiptype = "BT_FM_QUALCOMM_WCN3620";
        };
};
/* DTS2015012009883 wangjian 20140121 end > */
/* DTS2014041604760 shaopengxiang 20140417 end > */
/* DTS2015072404956 goupeipei 20150724 end > */
