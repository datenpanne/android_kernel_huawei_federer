/* < DTS2014120503050 lixiuzhen 20141205 begin */
/* < DTS2015010900746 yangzhenxi 20150109 begin */
/*                                      Regulations
1.The "DTSxxx" just be allowed to  add at the begin and the tail.
2.The dtsi files which belong to a group need to be put together,and will be separated by remarks.
3.When we add one new boardid,it would be inherted from the similar one
 and modify the product name in the files of huawei-fac.dtsi huawei-wifi.dtsi huawei-audio.dtsi,
 and the other groups need to do some modify with DTSxxx.
*/
/*belong to the component group, according to the order of i2c lcd tp camera sensors compass tricolors vibrator begin*/
/* < DTS2014121804508 wangcunyou 20141218 begin */
#include "huawei-i2c-detect-va.dtsi"
/* DTS2014121804508 wangcunyou 20141218 end > */
#include "huawei-lcd.dtsi"
/* < DTS2014121708088 sunlibin 20141217 begin */
#include "huawei-tp.dtsi"
/* DTS2014121708088 sunlibin 20141217 end > */
#include "huawei-camera.dtsi"
/* < DTS2014121804508 wangcunyou 20141218 begin */
#include "huawei-sensors.dtsi"
#include "huawei-vibrator.dtsi"
/* DTS2014121804508 wangcunyou 20141218 end > */
/*belong to the component group, according to the order of i2c lcd tp camera sensors compass tricolors vibrator end*/

/*belong to the wireless component group, according to the order of wifi bt fm audio begin*/
/* < DTS2014121300501 wanghao 20141213 begin */
#include "huawei-wifi.dtsi"
#include "huawei-bt.dtsi"
/* DTS2014121300501 wanghao 20141213 end > */
/* < DTS2014121300528 sujunfeng 20141213 begin */
#include "huawei-audio.dtsi"
/* DTS2014121300528 sujunfeng 20141213 end > */
/*belong to the wireless component group, according to the order of wifi bt fm audio end*/

/*belong to the factory group, according to the order of fac begin*/
#include "huawei-fac.dtsi"
/*belong to the factory group, according to the order of fac end*/

/*belong to the OS group, according to the order of battery memery begin*/
/* <DTS2014121201578 jiangfei 20141212 begin */
#include "huawei-battery.dtsi"
/* DTS2014121201578 jiangfei 20141212 end> */
/*#include "huawei-memory.dtsi"*/
/*belong to the OS group, according to the order of battery memery end*/

/*#include "huawei-emmc.dtsi" */
/* < DTS2014121206768 luchao 20141212 begin */
#include "huawei-sdcard.dtsi"
/* DTS2014121206768 luchao 20141212 end > */
/* DTS2014120503050 lixiuzhen 20141205 end > */
/* < DTS2014122400303 yuanzhen 20141224 begin */
#include "huawei-usb.dtsi"
/* DTS2015010900746 yangzhenxi 20150109 end > */
/* DTS2014122400303 yuanzhen 20141224 end > */
/* <DTS2015011303362 xupeipei 20150113 begin*/
#include "huawei-gpio.dtsi"
/* DTS2015011303362 xupeipei 20150113 end>*/
